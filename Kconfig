## Kconfig
```kconfig
# Copyright (c) 2022-2022 Huawei Technologies Co., Ltd. All rights reserved.
#
# UniProton is licensed under Mulan PSL v2.
# You can use this software according to the terms and conditions of the Mulan PSL v2.
# You may obtain a copy of Mulan PSL v2 at:
#          http://license.coscl.org.cn/MulanPSL2
# THIS SOFTWARE IS PROVIDED ON AN "AS IS" BASIS, WITHOUT WARRANTIES OF ANY KIND,
# EITHER EXPRESS OR IMPLIED, INCLUDING BUT NOT LIMITED TO NON-INFRINGEMENT,
# MERCHANTABILITY OR FIT FOR A PARTICULAR PURPOSE.
# See the Mulan PSL v2 for more details.
# Create: 2022-09-21
# Description: UniProton内核额外配置开关。

mainmenu "Kernel Configuration"

menu "Compiler"
choice
    prompt "Compiler type"
    default COMPILER_GCC
    help
      Choose compiler type.

config COMPILER_GCC
    bool "GCC"

config CROSS_COMPILE
    string
    depends on COMPILER_GCC
    default "arm-none-eabi-"

endchoice

endmenu

######################### config options of UniProton #####################

# Device Kconfig import
osource "$(DEVICE_PATH)/Kconfg"

menu "Stack Smashing Protector (SSP) Compiler Feature"

choice
    prompt "Enable stack buffer overflow detection"
    default  CC_STACKPROTECTOR_STRONG
    ---help---
    This option turns on the -fstack-protector GCC feature. This
    feature puts, at the beginning of functions, a canary value on
    the stack just before the return address, and validates
    the value just before actually returning.  Stack based buffer
    overflows (that need to overwrite this return address) now also
    overwrite the canary, which gets detected and the attack is then
    neutralized via a kernel panic.

    This feature requires gcc version 4.2 or above, or a distribution
    gcc with the feature backported. Older versions are automatically
    detected and for those versions, this configuration option is
    ignored. (and a warning is printed during bootup)

config CC_NO_STACKPROTECTOR
    bool "-fno-stack-protector"

config CC_STACKPROTECTOR
    bool "-fstack-protector"

config CC_STACKPROTECTOR_STRONG
    bool "-fstack-protector-strong"

config CC_STACKPROTECTOR_ALL
    bool "-fstack-protector-all"

endchoice

endmenu

config OS_SUPPORT_KERNEL_TEST
    bool "Enable kernel base test"
    default n
```

## config/Kconfig
```kconfig
mainmenu "UniProton Configuration"

#should source arch Kconfig first
source "config/arch/Kconfig"
source "config/core/Kconfig"
source "config/mem/Kconfig"
source "config/om/Kconfig"
source "config/security/Kconfig"
source "config/utility/Kconfig"
```

## config/arch/cpu/Kconfig
```kconfig
choice
	prompt "Platform Setup"
config OS_ARCH_ARMV7_M
	bool "ARMV7_M"
endchoice

source "config/arch/cpu/armv7-m/Kconfig"
```

## config/arch/cpu/armv7-m/Kconfig
```kconfig
menu "ARM7-M Sepecfic Configuration"

depends on OS_ARCH_ARMV7_M

config INTERNAL_OS_CORTEX_M4
	bool
	select INTERNAL_OS_BYTE_ORDER_LE

choice
	prompt "Cpu Type"

config INTERNAL_OS_PLATFORM_M4
	bool "CORTEX_M4"
	select INTERNAL_OS_CORTEX_M4

endchoice

config ARCH_CPU
    string
    default "cortex-m4" if INTERNAL_OS_CORTEX_M4

config THUMB
    string
    default "thumb"    if INTERNAL_OS_CORTEX_M4

choice
    prompt "Arch float type"
    default ARCH_FLOAT_SOFTFP

config ARCH_FLOAT_SOFT
    bool "soft"

config ARCH_FLOAT_SOFTFP
    bool "softfp"

config ARCH_FLOAT_HARD
    bool "hard"

endchoice

config ARCH_FLOAT
    string
    default "soft"     if ARCH_FLOAT_SOFT
    default "softfp"   if ARCH_FLOAT_SOFTFP
    default "hard"     if ARCH_FLOAT_HARD

choice
    prompt "Arch fpu type"
    default ARCH_FPU_VFPV4_D16

config ARCH_FPU_VFPV3
    bool "vfpv3"

config ARCH_FPU_VFPV3_D16
    bool "vfpv3-d16"

config ARCH_FPU_NEON_VFPV4
    bool "neon-vfpv4"

config ARCH_FPU_VFPV4
    bool "vfpv4"

config ARCH_FPU_VFPV4_D16
    bool "vfpv4-d16"

endchoice

config ARCH_FPU
    string
    default "vfpv3"        if ARCH_FPU_VFPV3
    default "vfpv3-d16"    if ARCH_FPU_VFPV3_D16
    default "neon-vfpv4"   if ARCH_FPU_NEON_VFPV4
    default "vfpv4"        if ARCH_FPU_VFPV4
    default "vfpv4-d16"    if ARCH_FPU_VFPV4_D16

source "config/arch/cpu/armv7-m/cortex-m4/Kconfig"

endmenu
```

## config/core/Kconfig
```kconfig
menu "Core Modules Configuration"

source "config/core/ipc/Kconfig"
source "config/core/kernel/Kconfig"

endmenu
```

## config/core/ipc/Kconfig
```kconfig
menu "IPC Modules Configuration"
source "config/core/ipc/event/Kconfig"
source "config/core/ipc/queue/Kconfig"
source "config/core/ipc/sem/Kconfig"

endmenu
```

## config/core/kernel/Kconfig
```kconfig
menu "Kernel Modules Configuration"
source "config/core/kernel/irq/Kconfig"
source "config/core/kernel/kexc/Kconfig"
source "config/core/kernel/sys/Kconfig"
source "config/core/kernel/task/Kconfig"
source "config/core/kernel/tick/Kconfig"
source "config/core/kernel/timer/Kconfig"
endmenu
```

## config/om/Kconfig
```kconfig
menu "OM Modules Configuration"

source "config/om/cpup/Kconfig"
source "config/om/err/Kconfig"
source "config/om/hook/Kconfig"

endmenu
#must ended with empty line
```
